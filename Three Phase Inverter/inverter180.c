/*
******************************************************************************
File:     main.c
Info:     Generated by Atollic TrueSTUDIO(R) 7.1.2   2018-01-08

The MIT License (MIT)
Copyright (c) 2009-2017 Atollic AB
******************************************************************************
*/

/* Includes */
#include "stm32f4xx.h"
#include "stm32f401_discovery.h"


int duty_cycle_50=4199;
int duty_cycle_33=2799;
int x=0;
TIM_TimeBaseInitTypeDef TIM_TimeBaseStructure;
TIM_OCInitTypeDef TIM_OCInitStructure;
GPIO_InitTypeDef GPIO_InitStructure;
TIM_BDTRInitTypeDef TIM_BDTRInitStructure;
void GPIO_Configuration(void)
{


	GPIO_InitTypeDef GPIO_InitStructure;


	/* GPIOA Configuration: Channel 1, 2, 3 and 4 as alternate function push-pull */
	GPIO_InitStructure.GPIO_Pin = (GPIO_Pin_8 |GPIO_Pin_10);
	GPIO_InitStructure.GPIO_Mode = GPIO_Mode_OUT;
	GPIO_InitStructure.GPIO_OType = GPIO_OType_PP;
	GPIO_InitStructure.GPIO_PuPd = GPIO_PuPd_NOPULL;
	GPIO_InitStructure.GPIO_Speed = GPIO_Speed_50MHz;

	GPIO_Init(GPIOA, &GPIO_InitStructure);


	/* GPIOB Configuration: Channel 1N, 2N and 3N as alternate function push-pull */
	GPIO_InitStructure.GPIO_Pin = (GPIO_Pin_13 | GPIO_Pin_14 | GPIO_Pin_15);
	GPIO_InitStructure.GPIO_Mode = GPIO_Mode_OUT;
	GPIO_InitStructure.GPIO_OType = GPIO_OType_PP;
	GPIO_InitStructure.GPIO_Speed = GPIO_Speed_50MHz;
	GPIO_Init(GPIOB, &GPIO_InitStructure);

	/* GPIOB Configuration: Channel 1N, 2N and 3N as alternate function push-pull */
	GPIO_InitStructure.GPIO_Pin = (GPIO_Pin_11);
	GPIO_InitStructure.GPIO_Mode = GPIO_Mode_OUT;
	GPIO_InitStructure.GPIO_OType = GPIO_OType_PP;
	GPIO_InitStructure.GPIO_Speed = GPIO_Speed_50MHz;
	GPIO_Init(GPIOE, &GPIO_InitStructure);
}


void TM_Configuration2(){
	TIM_TimeBaseStructure.TIM_Prescaler = 335;
	TIM_TimeBaseStructure.TIM_CounterMode = TIM_CounterMode_Up;
	TIM_TimeBaseStructure.TIM_Period = 4999;		//50Hz
	TIM_TimeBaseStructure.TIM_ClockDivision = 0;
	TIM_TimeBaseStructure.TIM_RepetitionCounter = 0;

	TIM_TimeBaseInit(TIM4, &TIM_TimeBaseStructure);
	TIM_Cmd(TIM4, ENABLE);
}


uint8_t a,b,c,a1,b1,c1;
int freq=4999;
int main(void)
{
	SystemInit();
	RCC_APB1PeriphClockCmd(RCC_APB1Periph_TIM4, ENABLE);
	RCC_AHB1PeriphClockCmd(RCC_AHB1Periph_GPIOA |RCC_AHB1Periph_GPIOB|RCC_AHB1Periph_GPIOE,ENABLE);

	GPIO_Configuration();
	GPIOA->MODER |= ((0x1 << 16) | (0x1 << 18) | (0x1 << 20));

	TM_Configuration2();
	while(1){

		int timerValue = TIM_GetCounter(TIM4);
		if(timerValue==0){
			GPIO_SetBits(GPIOA,GPIO_Pin_8);//1
			GPIO_ResetBits(GPIOB,GPIO_Pin_13);//2
		}
		else if(timerValue==freq/6){
			GPIO_SetBits(GPIOB,GPIO_Pin_15);//6
			GPIO_ResetBits(GPIOA,GPIO_Pin_10);//5
		}
		else if(timerValue==2*freq/6){
			GPIO_SetBits(GPIOE,GPIO_Pin_11);//3
			GPIO_ResetBits(GPIOB,GPIO_Pin_14);//4
		}
		else if(timerValue==3*freq/6){
			GPIO_SetBits(GPIOB,GPIO_Pin_13);
			GPIO_ResetBits(GPIOA,GPIO_Pin_8);
		}
		else if(timerValue==4*freq/6){
			GPIO_SetBits(GPIOA,GPIO_Pin_10);
			GPIO_ResetBits(GPIOB,GPIO_Pin_15);
		}
		else if(timerValue==5*freq/6){
			GPIO_SetBits(GPIOB,GPIO_Pin_14);
			GPIO_ResetBits(GPIOE,GPIO_Pin_11);
		}
	}
}
